## meta-numaker/conf/layer.conf
```bitbake
# meta-numaker parent layer configuration
BBPATH .= ":${LAYERDIR}"

BBFILES += "${LAYERDIR}/recipes-*/*/*.bb ${LAYERDIR}/recipes-*/*/*.bbappend"

BBFILE_COLLECTIONS += "numaker-layer"
BBFILE_PATTERN_numaker-layer := "^${LAYERDIR}/"
BBFILE_PATTERN_IGNORE_EMPTY_numaker-layer = "1"
BBFILE_PRIORITY_numaker-layer = "6"

LAYERSERIES_COMPAT_numaker-layer = "wrynose"
```

## meta-numaker/meta-evb-ma35/recipes-kernel/linux/files/ma35d0_bmc_defconfig
```kconfig
# MA35D0 OpenBMC minimal kernel configuration
# Stripped for BMC use - no WiFi, Audio, Display, Camera, USB host, CAN, NFS

# ---- General ----
# CONFIG_LOCALVERSION_AUTO is not set
CONFIG_DEFAULT_HOSTNAME="ma35d0-bmc"
CONFIG_SYSVIPC=y
CONFIG_POSIX_MQUEUE=y
CONFIG_NO_HZ=y
CONFIG_HIGH_RES_TIMERS=y
CONFIG_PREEMPT_VOLUNTARY=y
CONFIG_LOG_BUF_SHIFT=16
CONFIG_CC_OPTIMIZE_FOR_SIZE=y
CONFIG_EXPERT=y

# ---- Cgroups (required by systemd) ----
CONFIG_CGROUPS=y
CONFIG_MEMCG=y
CONFIG_BLK_CGROUP=y
CONFIG_CGROUP_SCHED=y
CONFIG_CGROUP_PIDS=y
CONFIG_CGROUP_FREEZER=y
CONFIG_CPUSETS=y
CONFIG_CGROUP_DEVICE=y
CONFIG_CGROUP_CPUACCT=y

# ---- Namespaces (required by systemd) ----
CONFIG_NAMESPACES=y
CONFIG_UTS_NS=y
CONFIG_IPC_NS=y
CONFIG_PID_NS=y
CONFIG_NET_NS=y

# ---- Initrd ----
CONFIG_BLK_DEV_INITRD=y
# CONFIG_RD_BZIP2 is not set
# CONFIG_RD_LZMA is not set
# CONFIG_RD_XZ is not set
# CONFIG_RD_LZO is not set
# CONFIG_RD_LZ4 is not set

# ---- Architecture ----
CONFIG_ARCH_MA35D0=y
# CONFIG_ARM64_ERRATUM_826319 is not set
# CONFIG_ARM64_ERRATUM_827319 is not set
# CONFIG_ARM64_ERRATUM_824069 is not set
# CONFIG_ARM64_ERRATUM_819472 is not set
# CONFIG_ARM64_ERRATUM_832075 is not set
# CONFIG_ARM64_ERRATUM_845719 is not set
# CONFIG_ARM64_ERRATUM_843419 is not set
# CONFIG_ARM64_ERRATUM_1024718 is not set
# CONFIG_ARM64_ERRATUM_1463225 is not set
# CONFIG_CAVIUM_ERRATUM_22375 is not set
# CONFIG_CAVIUM_ERRATUM_23154 is not set
# CONFIG_CAVIUM_ERRATUM_27456 is not set
# CONFIG_CAVIUM_ERRATUM_30115 is not set
# CONFIG_HISILICON_ERRATUM_161600802 is not set
# CONFIG_QCOM_FALKOR_ERRATUM_1003 is not set
# CONFIG_QCOM_FALKOR_ERRATUM_1009 is not set
# CONFIG_QCOM_QDF2400_ERRATUM_0065 is not set
# CONFIG_QCOM_FALKOR_ERRATUM_E1041 is not set
# CONFIG_SOCIONEXT_SYNQUACER_PREITS is not set
# CONFIG_FSL_ERRATUM_A008585 is not set
# CONFIG_HISILICON_ERRATUM_161010101 is not set
# CONFIG_ARM64_ERRATUM_858921 is not set
CONFIG_ARM64_VA_BITS_48=y
CONFIG_NR_CPUS=2
# CONFIG_NUMA is not set
CONFIG_HZ_250=y
CONFIG_COMPAT=y
# CONFIG_ARM64_HW_AFDBM is not set
# CONFIG_ARM64_PAN is not set
# CONFIG_ARM64_SVE is not set

# ---- Power management ----
CONFIG_WQ_POWER_EFFICIENT_DEFAULT=y
CONFIG_CPU_IDLE=y
CONFIG_ARM_PSCI_CPUIDLE=y
CONFIG_CPU_FREQ=y
CONFIG_CPU_FREQ_DEFAULT_GOV_ONDEMAND=y
CONFIG_CPUFREQ_DT=y

# ---- Modules ----
CONFIG_MODULES=y
CONFIG_MODULE_UNLOAD=y

# ---- Block / Partition ----
CONFIG_PARTITION_ADVANCED=y
# CONFIG_COMPAT_BRK is not set

# ---- Memory ----
CONFIG_DEFAULT_MMAP_MIN_ADDR=32768

# ---- Networking ----
CONFIG_NET=y
CONFIG_PACKET=y
CONFIG_UNIX=y
CONFIG_INET=y
CONFIG_IP_MULTICAST=y
CONFIG_IP_PNP=y
CONFIG_IP_PNP_DHCP=y
CONFIG_IPV6=y
CONFIG_NETFILTER=y
# CONFIG_WIRELESS is not set

# ---- Device infrastructure ----
CONFIG_DEVTMPFS=y
CONFIG_DEVTMPFS_MOUNT=y
CONFIG_FW_LOADER=y

# ---- MTD / Flash ----
CONFIG_MTD=y
CONFIG_MTD_BLOCK=y
CONFIG_MTD_RAW_NAND=y
CONFIG_MTD_NAND_NUVOTON_MA35=y
CONFIG_MTD_SPI_NAND=y
CONFIG_MTD_SPI_NOR=y
CONFIG_MTD_UBI=y
CONFIG_MTD_UBI_FASTMAP=y
CONFIG_MTD_UBI_BLOCK=y

# ---- Device Tree Overlay ----
CONFIG_OF_OVERLAY=y

# ---- RAM disk (for initramfs if needed) ----
CONFIG_BLK_DEV_RAM=y

# ---- Timer ----
CONFIG_MA35D0_TIMER=y

# ---- Network device ----
CONFIG_NETDEVICES=y
CONFIG_STMMAC_ETH=y
# CONFIG_DWMAC_GENERIC is not set
CONFIG_DWMAC_NUVOTON=y
CONFIG_REALTEK_PHY=y
# CONFIG_USB_NET_DRIVERS is not set

# ---- Input (minimal) ----
# CONFIG_INPUT_LEDS is not set
# CONFIG_KEYBOARD_ATKBD is not set
# CONFIG_INPUT_MOUSE is not set
# CONFIG_INPUT_TOUCHSCREEN is not set
# CONFIG_SERIO is not set

# ---- Serial / Console ----
# CONFIG_LEGACY_PTYS is not set
CONFIG_SERIAL_MA35D0=y
CONFIG_SERIAL_MA35D0_CONSOLE=y
CONFIG_SERIAL_DEV_BUS=y

# ---- Hardware RNG ----
CONFIG_HW_RANDOM=y

# ---- I2C ----
CONFIG_I2C=y
CONFIG_I2C_CHARDEV=y
CONFIG_I2C_MA35D0=y

# ---- SPI ----
CONFIG_SPI=y
CONFIG_SPI_BITBANG=y
CONFIG_SPI_MEM=y
CONFIG_SPI_MA35D0_QSPI=y

# ---- GPIO ----
CONFIG_GPIOLIB=y
CONFIG_GPIO_SYSFS=y

# ---- Watchdog ----
CONFIG_WATCHDOG=y

# ---- Thermal ----
CONFIG_THERMAL=y
CONFIG_THERMAL_WRITABLE_TRIPS=y
CONFIG_THERMAL_GOV_USER_SPACE=y
CONFIG_MA35D0_THERMAL=y

# ---- Regulator ----
CONFIG_REGULATOR=y
CONFIG_REGULATOR_MA35D0=y
CONFIG_REGULATOR_GPIO=y

# ---- PWM (fan control) ----
CONFIG_PWM=y
CONFIG_PWM_MA35D0=y

# ---- IIO / ADC ----
CONFIG_IIO=y
CONFIG_MA35_ADC=y

# ---- DMA ----
CONFIG_DMADEVICES=y
CONFIG_MA35D0_DMA=y

# ---- RTC ----
CONFIG_RTC_CLASS=y
# CONFIG_RTC_HCTOSYS is not set
# CONFIG_RTC_SYSTOHC is not set
CONFIG_RTC_DRV_MA35D0=y

# ---- PHY ----
CONFIG_PHY_MA35_USB=y

# ---- Filesystems ----
CONFIG_TMPFS=y
CONFIG_TMPFS_POSIX_ACL=y
CONFIG_SQUASHFS=y
CONFIG_SQUASHFS_XZ=y
CONFIG_SQUASHFS_ZSTD=y
CONFIG_JFFS2_FS=y
CONFIG_JFFS2_SUMMARY=y
CONFIG_UBIFS_FS=y
CONFIG_UBIFS_FS_ADVANCED_COMPR=y
# CONFIG_NETWORK_FILESYSTEMS is not set

# ---- Security / Crypto ----
CONFIG_CRYPTO_USER=y
CONFIG_CRYPTO_USER_API_HASH=y
CONFIG_CRYPTO_USER_API_SKCIPHER=y
CONFIG_CRYPTO_GHASH_ARM64_CE=y
CONFIG_CRYPTO_SHA1_ARM64_CE=y
CONFIG_CRYPTO_SHA2_ARM64_CE=y
CONFIG_CRYPTO_AES_ARM64_CE_BLK=y

# ---- Misc required by systemd ----
CONFIG_AUTOFS_FS=y
CONFIG_INOTIFY_USER=y
CONFIG_SIGNALFD=y
CONFIG_TIMERFD=y
CONFIG_EPOLL=y
CONFIG_FHANDLE=y
CONFIG_DMIID=y
CONFIG_NET_SCHED=y
CONFIG_SECCOMP=y
CONFIG_SECCOMP_FILTER=y
CONFIG_CHECKPOINT_RESTORE=y
CONFIG_PROC_CHILDREN=y

# ---- Kernel compression ----
CONFIG_XZ_DEC=y

# ---- Debugging (minimal for production) ----
CONFIG_PANIC_ON_OOPS=y
CONFIG_PANIC_TIMEOUT=5
# CONFIG_DEBUG_FS is not set
# CONFIG_PROFILING is not set

# ---- Disable unneeded subsystems ----
# CONFIG_SOUND is not set
# CONFIG_DRM is not set
# CONFIG_FB is not set
# CONFIG_CAN is not set
# CONFIG_MEDIA_SUPPORT is not set
# CONFIG_USB_SUPPORT is not set
# CONFIG_MMC is not set
CONFIG_NEW_LEDS=y
CONFIG_LEDS_CLASS=y
CONFIG_LEDS_GPIO=y
CONFIG_LEDS_TRIGGERS=y
CONFIG_LEDS_TRIGGER_TIMER=y
# CONFIG_IOMMU_SUPPORT is not set
# CONFIG_REMOTEPROC is not set
# CONFIG_PM_DEVFREQ is not set
# CONFIG_TEE is not set
# CONFIG_STAGING is not set
# CONFIG_HWSPINLOCK is not set
# CONFIG_CRYPTO_DEV_NUVOTON_MA35 is not set
# CONFIG_MA35_KEYSTORE is not set
# CONFIG_HW_RANDOM_MA35 is not set
# CONFIG_LIBNVDIMM is not set
```

## meta-numaker/meta-evb-ma35d0/conf/layer.conf
```bitbake
# Layer configuration for meta-evb-ma35d0
BBPATH .= ":${LAYERDIR}"
BBFILES += "${LAYERDIR}/recipes-*/*/*.bb \
            ${LAYERDIR}/recipes-*/*/*.bbappend"

BBFILE_COLLECTIONS += "evb-ma35d0-layer"
BBFILE_PATTERN_evb-ma35d0-layer := "^${LAYERDIR}/"
BBFILE_PRIORITY_evb-ma35d0-layer = "7"

LAYERSERIES_COMPAT_evb-ma35d0-layer = "wrynose"
LAYERDEPENDS_evb-ma35d0-layer = "numaker-layer meta-arm"
```

## meta-numaker/meta-evb-ma35d05k/conf/layer.conf
```bitbake
# Layer configuration for meta-evb-ma35d05k
BBPATH .= ":${LAYERDIR}"
BBFILES += "${LAYERDIR}/recipes-*/*/*.bb \
            ${LAYERDIR}/recipes-*/*/*.bbappend"

BBFILE_COLLECTIONS += "evb-ma35d05k-layer"
BBFILE_PATTERN_evb-ma35d05k-layer := "^${LAYERDIR}/"
BBFILE_PRIORITY_evb-ma35d05k-layer = "7"

LAYERSERIES_COMPAT_evb-ma35d05k-layer = "wrynose"
LAYERDEPENDS_evb-ma35d05k-layer = "numaker-layer meta-arm"
```

## meta-numaker/meta-evb-nuc980/conf/layer.conf
```bitbake
# Layer configuration for meta-evb-nuc980
BBPATH .= ":${LAYERDIR}"
BBFILES += "${LAYERDIR}/recipes-*/*/*.bb \
            ${LAYERDIR}/recipes-*/*/*.bbappend"

BBFILE_COLLECTIONS += "evb-nuc980-layer"
BBFILE_PATTERN_evb-nuc980-layer := "^${LAYERDIR}/"
BBFILE_PRIORITY_evb-nuc980-layer = "7"

LAYERSERIES_COMPAT_evb-nuc980-layer = "wrynose"
LAYERDEPENDS_evb-nuc980-layer = "numaker-layer"
```

## meta-numaker/meta-evb-nuc980/recipes-kernel/linux/linux-nuc980/defconfig
```kconfig
# NUC980 OpenBMC defconfig
# Based on nuc980_defconfig with OpenBMC systemd/LED/GPIO requirements merged
# and unused peripherals (USB, CAN, sound, media, FMI NAND) disabled.

# CONFIG_LOCALVERSION_AUTO is not set
CONFIG_SYSVIPC=y
# CONFIG_CROSS_MEMORY_ATTACH is not set
CONFIG_USELIB=y
CONFIG_NO_HZ_IDLE=y
CONFIG_HIGH_RES_TIMERS=y
CONFIG_PREEMPT=y
CONFIG_BSD_PROCESS_ACCT=y
CONFIG_BSD_PROCESS_ACCT_V3=y

# --- Namespaces & cgroups (required by systemd) ---
CONFIG_CGROUPS=y
CONFIG_CGROUP_FREEZER=y
CONFIG_CGROUP_DEVICE=y
CONFIG_CGROUP_CPUACCT=y
CONFIG_CGROUP_PIDS=y
CONFIG_CGROUP_SCHED=y
CONFIG_MEMCG=y
CONFIG_NAMESPACES=y
CONFIG_UTS_NS=y
CONFIG_IPC_NS=y
CONFIG_PID_NS=y
CONFIG_NET_NS=y

CONFIG_INITRAMFS_SOURCE="../rootfs"
# CONFIG_RD_BZIP2 is not set
# CONFIG_RD_LZMA is not set
# CONFIG_RD_LZO is not set
# CONFIG_RD_LZ4 is not set
# CONFIG_RD_ZSTD is not set
CONFIG_BOOT_CONFIG=y
CONFIG_EXPERT=y
# CONFIG_ARCH_MULTIPLATFORM is not set
# CONFIG_ARCH_MULTI_V7 is not set
CONFIG_ARCH_NUC980=y
CONFIG_AEABI=y
# CONFIG_CPU_SW_DOMAIN_PAN is not set
# CONFIG_ARM_MODULE_PLTS is not set
CONFIG_ZBOOT_ROM_TEXT=0
CONFIG_ZBOOT_ROM_BSS=0
CONFIG_CMDLINE="root=/dev/ram0 console=ttyS0,115200n8 rdinit=/linuxrc mem=64M"
# CONFIG_SUSPEND is not set
CONFIG_SECCOMP=y
CONFIG_SECCOMP_FILTER=y
CONFIG_MODULES=y
CONFIG_MODULE_UNLOAD=y
# CONFIG_IOSCHED_BFQ is not set
# CONFIG_CORE_DUMP_DEFAULT_ELF_HEADERS is not set
# CONFIG_SWAP is not set
# CONFIG_COMPAT_BRK is not set

# --- Networking ---
CONFIG_NET=y
CONFIG_PACKET=y
CONFIG_PACKET_DIAG=y
CONFIG_UNIX=y
CONFIG_UNIX_DIAG=y
CONFIG_INET=y
CONFIG_IP_MULTICAST=y
# CONFIG_INET_DIAG is not set
# CONFIG_CAN is not set
# CONFIG_WIRELESS is not set

# --- Device model ---
CONFIG_UEVENT_HELPER=y
CONFIG_UEVENT_HELPER_PATH="/sbin/hotplug"
CONFIG_DEVTMPFS=y
CONFIG_DEVTMPFS_MOUNT=y
# CONFIG_STANDALONE is not set
# CONFIG_PREVENT_FIRMWARE_BUILD is not set

# --- MTD / SPI NAND / UBI ---
# CONFIG_FMI_NUC980 is not set
CONFIG_MTD=y
CONFIG_MTD_BLOCK=y
CONFIG_MTD_PLATRAM=y
CONFIG_MTD_BLOCK2MTD=y
CONFIG_MTD_RAW_NAND=y
CONFIG_MTD_SPI_NAND=y
CONFIG_MTD_SPI_NOR=y
CONFIG_MTD_UBI=y

# --- Block devices ---
CONFIG_BLK_DEV_RAM=y
CONFIG_BLK_DEV_RAM_SIZE=32768

# --- SCSI (needed for some block devices) ---
CONFIG_SCSI=y
# CONFIG_SCSI_PROC_FS is not set
CONFIG_BLK_DEV_SD=y
# CONFIG_SCSI_LOWLEVEL is not set

# --- Networking drivers ---
CONFIG_NETDEVICES=y
CONFIG_DUMMY=y
# CONFIG_NET_VENDOR_ALACRITECH is not set
# CONFIG_NET_VENDOR_AMAZON is not set
# CONFIG_NET_VENDOR_AQUANTIA is not set
# CONFIG_NET_VENDOR_ARC is not set
# CONFIG_NET_VENDOR_BROADCOM is not set
# CONFIG_NET_VENDOR_CADENCE is not set
# CONFIG_NET_VENDOR_CAVIUM is not set
# CONFIG_NET_VENDOR_CIRRUS is not set
# CONFIG_NET_VENDOR_EZCHIP is not set
# CONFIG_NET_VENDOR_FARADAY is not set
# CONFIG_NET_VENDOR_GOOGLE is not set
# CONFIG_NET_VENDOR_HISILICON is not set
# CONFIG_NET_VENDOR_HUAWEI is not set
# CONFIG_NET_VENDOR_INTEL is not set
# CONFIG_NET_VENDOR_MARVELL is not set
# CONFIG_NET_VENDOR_MELLANOX is not set
# CONFIG_NET_VENDOR_MICREL is not set
# CONFIG_NET_VENDOR_MICROCHIP is not set
# CONFIG_NET_VENDOR_MICROSEMI is not set
# CONFIG_NET_VENDOR_NI is not set
# CONFIG_NET_VENDOR_NATSEMI is not set
# CONFIG_NET_VENDOR_NETRONOME is not set
CONFIG_NUC980_ETH0=y
# CONFIG_NUC980_ETH1 is not set
# CONFIG_NET_VENDOR_PENSANDO is not set
# CONFIG_NET_VENDOR_QUALCOMM is not set
# CONFIG_NET_VENDOR_RENESAS is not set
# CONFIG_NET_VENDOR_ROCKER is not set
# CONFIG_NET_VENDOR_SAMSUNG is not set
# CONFIG_NET_VENDOR_SEEQ is not set
# CONFIG_NET_VENDOR_SOLARFLARE is not set
# CONFIG_NET_VENDOR_SMSC is not set
# CONFIG_NET_VENDOR_SOCIONEXT is not set
# CONFIG_NET_VENDOR_STMICRO is not set
# CONFIG_NET_VENDOR_SYNOPSYS is not set
# CONFIG_NET_VENDOR_VIA is not set
# CONFIG_NET_VENDOR_WIZNET is not set
# CONFIG_NET_VENDOR_XILINX is not set
# CONFIG_USB_NET_DRIVERS is not set
# CONFIG_WLAN is not set

# --- Input ---
CONFIG_INPUT_EVDEV=y
# CONFIG_INPUT_KEYBOARD is not set
# CONFIG_INPUT_MOUSE is not set
# CONFIG_INPUT_TOUCHSCREEN is not set
# CONFIG_SERIO is not set

# --- Serial / Console ---
# CONFIG_LEGACY_PTYS is not set
CONFIG_SERIAL_NUC980=y
CONFIG_SERIAL_NUC980_CONSOLE=y
# CONFIG_NUC980_UART1 is not set
# CONFIG_NUC980_UART2 is not set
# CONFIG_NUC980_UART3 is not set
# CONFIG_NUC980_UART4 is not set
# CONFIG_NUC980_UART5 is not set
# CONFIG_NUC980_UART6 is not set
# CONFIG_NUC980_UART7 is not set
# CONFIG_NUC980_UART8 is not set
# CONFIG_NUC980_UART9 is not set
# CONFIG_HW_RANDOM is not set

# --- I2C ---
CONFIG_I2C=y
CONFIG_I2C_CHARDEV=y
CONFIG_I2C_GPIO=y
# CONFIG_I2C_BUS_NUC980_P0 is not set
CONFIG_I2C_BUS_NUC980_P1=y
# CONFIG_I2C_BUS_NUC980_P2 is not set
CONFIG_I2C_BUS_NUC980_P3=y

# --- SPI ---
CONFIG_SPI=y
CONFIG_SPI_NUC980_QSPI=y
CONFIG_SPI_NUC980_SPI=y
CONFIG_SPI_SPIDEV=y
# CONFIG_PTP_1588_CLOCK is not set

# --- Pinctrl & GPIO ---
CONFIG_PINCTRL_SINGLE=y
CONFIG_PINCTRL_NUC980=y
CONFIG_GPIO_SYSFS=y
CONFIG_GPIO_NUC980=y
CONFIG_GPIOLIB=y
CONFIG_GPIO_CDEV=y

# --- Watchdog ---
CONFIG_WATCHDOG=y
CONFIG_NUC980_WDT=y
CONFIG_NUC980_WWDT=y

# --- LEDs ---
CONFIG_NEW_LEDS=y
CONFIG_LEDS_CLASS=y
CONFIG_LEDS_GPIO=y
CONFIG_LEDS_TRIGGERS=y
CONFIG_LEDS_TRIGGER_DEFAULT_ON=y
CONFIG_LEDS_TRIGGER_TIMER=y
CONFIG_LEDS_TRIGGER_HEARTBEAT=y

# --- USB (disabled for BMC) ---
# CONFIG_USB_SUPPORT is not set

# --- Sound (disabled) ---
# CONFIG_SOUND is not set

# --- Media (disabled) ---
# CONFIG_MEDIA_SUPPORT is not set

# --- Framebuffer (disabled) ---
# CONFIG_FB is not set

# --- HID (disabled) ---
# CONFIG_HID is not set

# --- MMC/SD (disabled) ---
# CONFIG_MMC is not set

# --- RTC ---
CONFIG_RTC_CLASS=y
CONFIG_RTC_DRV_NUC980=y

# --- DMA ---
CONFIG_DMADEVICES=y
CONFIG_NUC980_DMA=y

# --- IIO / ADC (disabled) ---
# CONFIG_IIO is not set

# --- PWM (disabled) ---
# CONFIG_PWM is not set

# --- Filesystem ---
# CONFIG_DNOTIFY is not set
CONFIG_MSDOS_FS=y
CONFIG_VFAT_FS=y
CONFIG_TMPFS=y
CONFIG_TMPFS_POSIX_ACL=y
CONFIG_TMPFS_XATTR=y
CONFIG_JFFS2_FS=y
CONFIG_UBIFS_FS=y
CONFIG_UBIFS_FS_ADVANCED_COMPR=y
CONFIG_NLS_CODEPAGE_437=y
CONFIG_NLS_ISO8859_1=y
CONFIG_AUTOFS_FS=y

# --- Systemd requirements ---
CONFIG_INOTIFY_USER=y
CONFIG_SIGNALFD=y
CONFIG_TIMERFD=y
CONFIG_EPOLL=y
CONFIG_FHANDLE=y
CONFIG_DMIID=y

# --- Security ---
CONFIG_LSM="lockdown,yama,loadpin,safesetid,integrity,bpf"
CONFIG_INIT_STACK_NONE=y

# --- Crypto ---
CONFIG_CRYPTO_USER=y
CONFIG_CRYPTO_SEQIV=y
CONFIG_CRYPTO_USER_API_HASH=y
CONFIG_CRYPTO_USER_API_SKCIPHER=y
CONFIG_CRYPTO_USER_API_RNG=y
CONFIG_CRYPTO_USER_API_AEAD=y
CONFIG_CRYPTO_DEV_NUC980=y
CONFIG_CRC_CCITT=y

# --- Debug ---
CONFIG_DEBUG_FS=y
CONFIG_DEBUG_PREEMPT=y
# CONFIG_FTRACE is not set
CONFIG_STRICT_DEVMEM=y
CONFIG_UNWINDER_FRAME_POINTER=y
```
